## dts/bindings/sensor/maxim,max31856.yaml
```yaml
# Copyright (c) 2020, Christian Hirsch
# SPDX-License-Identifier: Apache-2.0

description: MAX31856 Precision Thermocouple to Digital Converter with Linearization

compatible: "maxim,max31856"

include: [sensor-device.yaml, spi-device.yaml]
```
